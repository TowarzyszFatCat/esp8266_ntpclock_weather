#include <SPI.h>
#include <Wire.h>
#include <Adafruit_GFX.h>
#include <Adafruit_SSD1306.h>
#include <DHT.h>
#include <NTPClient.h>
#include <ESP8266WiFi.h>
#include <WiFiUdp.h>
#include <Arduino_JSON.h>


// Credintials
const char *ssid     = " ";
const char *password = " ";
String newHostname = "Clock";
IPAddress ip;


// Date
String weekDays[7]={"ND", "PN", "WT", "SR", "CZ", "PT", "SB"};
String months[12]={"STY", "LUT", "MAR", "KWI", "MAJ", "CZE", "LIP", "SIE", "WRZ", "PAZ", "LIS", "GRU"};


WiFiUDP ntpUDP;
NTPClient timeClient(ntpUDP, "pl.pool.ntp.org", 3600);

#pragma region dht
//Specyfikacja DHT
#define DHTPIN 0
#define DHTTYPE DHT11
DHT dht(DHTPIN, DHTTYPE);
#pragma endregion

#pragma region oled
//Specyfikacja wyświetlacza
#define SCREEN_WIDTH 128
#define SCREEN_HEIGHT 64
#define OLED_RESET     -1
Adafruit_SSD1306 display(SCREEN_WIDTH, SCREEN_HEIGHT, &Wire, OLED_RESET);
#pragma endregion

#pragma region chars
const unsigned char amogus [1024] PROGMEM = {
	0xff, 0xff, 0xff, 0xff, 0xff, 0xff, 0xff, 0xff, 0xff, 0xff, 0xff, 0xff, 0xff, 0xff, 0xff, 0xff, 
	0xff, 0xff, 0xff, 0xff, 0xff, 0xff, 0xff, 0xff, 0xff, 0xff, 0xff, 0xff, 0xff, 0xff, 0xff, 0xff, 
	0xff, 0xff, 0xff, 0xff, 0xff, 0xff, 0xff, 0xff, 0xff, 0xc0, 0x00, 0x1f, 0xff, 0xff, 0xff, 0xff, 
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	0xff, 0xff, 0xff, 0xff, 0xff, 0xff, 0xff, 0xff, 0xff, 0xff, 0xff, 0xff, 0xff, 0xff, 0xff, 0xff
  };

const unsigned char amongus_left [1024] PROGMEM = {
	0x00, 0x00, 0x00, 0x00, 0x00, 0x00, 0x00, 0x00, 0x00, 0x00, 0x00, 0x00, 0x00, 0x00, 0x00, 0x00, 
	0x00, 0x00, 0x00, 0x00, 0x00, 0x00, 0x00, 0x00, 0x00, 0x00, 0x00, 0x00, 0x00, 0x00, 0x00, 0x00, 
	0x00, 0x00, 0x00, 0x00, 0x00, 0x00, 0x00, 0x00, 0x00, 0x00, 0x00, 0x00, 0x00, 0x00, 0x00, 0x00, 
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	0x00, 0x00, 0x00, 0x00, 0x00, 0x00, 0x00, 0x00, 0x00, 0x00, 0x00, 0x00, 0x00, 0x00, 0x00, 0x00
};

const unsigned char kurwinox [] PROGMEM = {
	0x00, 0x00, 0x00, 0x00, 0x00, 0x00, 0x00, 0x00, 0x00, 0x00, 0x00, 0x00, 0x00, 0x00, 0x00, 0x00, 
	0x00, 0x00, 0x00, 0x00, 0x00, 0x00, 0x00, 0x00, 0x00, 0x00, 0x00, 0x00, 0x00, 0x00, 0x00, 0x00, 
	0x00, 0x00, 0x00, 0x00, 0x00, 0x00, 0x00, 0x00, 0x00, 0x00, 0x00, 0x00, 0x00, 0x00, 0x00, 0x00, 
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	0x00, 0x00, 0x00, 0x00, 0x00, 0x00, 0x00, 0x00, 0x00, 0x00, 0x00, 0x00, 0x00, 0x00, 0x00, 0x00
};

const unsigned char aaa [1024] PROGMEM = {
	0x01, 0x80, 0x00, 0x00, 0x01, 0xff, 0xff, 0xff, 0xff, 0xff, 0xff, 0xff, 0xff, 0xff, 0xff, 0xff, 
	0x00, 0x80, 0x00, 0x00, 0x00, 0x00, 0x7f, 0xff, 0xff, 0xff, 0xff, 0xff, 0xff, 0xff, 0xff, 0xff, 
	0x3f, 0x80, 0x00, 0x00, 0x00, 0x00, 0x06, 0x7f, 0xff, 0xff, 0xff, 0xff, 0xff, 0xff, 0xff, 0xff, 
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	0x00, 0x00, 0x00, 0x00, 0x00, 0x00, 0x00, 0x00, 0x00, 0x00, 0x00, 0x7f, 0xff, 0xff, 0xff, 0xff
};




#pragma endregion

#pragma region buttons
#define touchButton 3
#pragma endregion

#pragma region functions
float getTemp(){
  float t = dht.readTemperature();
  return t;
}

float getHum(){
  float h = dht.readHumidity();
  return h;
}

#pragma endregion

int touchValue = 0;
int screenIndex = 0;

int maxIndex = 2;

void setup() {
  // OLED SETUP
  Wire.begin(2,1); 
  if(!display.begin(SSD1306_SWITCHCAPVCC, 0x3C)) {
    Serial.println(F("SSD1306 allocation failed"));
  for(;;);}
  delay(2000);
  display.clearDisplay();

  // PINMODE SETUP
  pinMode(LED_BUILTIN, OUTPUT); //Led płytka
  pinMode(touchButton, INPUT);

  WiFi.begin(ssid, password);
  WiFi.hostname(newHostname.c_str());

  display.clearDisplay();
  display.setCursor(0, 0);
  display.setTextColor(WHITE);
  display.println("Uruchamianie...");
  display.display();
  delay(500);
  display.clearDisplay();
  display.print("---------------------");
  display.println("SSID: " + String(ssid));
  display.println("Hostname: " + newHostname);
  display.println("---------------------");
  display.display();

  while ( WiFi.status() != WL_CONNECTED ) {
    display.setCursor(0, 0);
    display.println("Laczenie z WiFi");
    display.display();
    delay(400);
    display.setCursor(0, 0);
    display.println("Laczenie z WiFi.");
    display.display();
    delay(400);
    display.setCursor(0, 0);
    display.println("Laczenie z WiFi..");
    display.display();
    delay(400);
    display.setCursor(0, 0);
    display.println("Laczenie z WiFi...");
    display.display();
    delay(400);
  }

  if(WiFi.status() == WL_CONNECTED){
    display.setTextSize(1);
    display.setCursor(0, 0);
    display.println(" ");
    display.println(" ");
    display.println(" ");
    display.println(" ");
    display.println(" ");
    display.println("Polaczono!");
    display.display();
    delay(1000);
    ip = WiFi.localIP();
    display.print("IP: ");
    display.print(ip);
    display.display();
    delay(2500);
  }

  timeClient.begin();

  // START DHT11
  dht.begin();
}

void loop() {

  timeClient.update();
  int hour = timeClient.getHours();
  int minute = timeClient.getMinutes();
  int second = timeClient.getSeconds();

  String hourstr = String(hour);
  String minutestr = String(minute);
  String secondstr = String(second);

  if(hourstr.length() == 1){
    hourstr = "0" + hourstr;
  }
  if(minutestr.length() == 1){
    minutestr = "0" + minutestr;
  }
  if(secondstr.length() == 1){
    secondstr = "0" + secondstr;
  }


  #pragma region screenIndex
  touchValue = digitalRead(touchButton);
  if(touchValue){
    screenIndex++;
    if(screenIndex == 2){
      screenIndex = 0;
    }
    delay(500);
  }
  #pragma endregion

  if(screenIndex == 0){
    display.clearDisplay();
    display.setCursor(0, 0);
    display.setTextColor(WHITE);
    display.drawBitmap(0, 0, amongus_left, 128, 64, WHITE);
    display.setTextSize(2);
    display.setCursor(50,10);
    display.print(hourstr + ":" + minutestr);
    display.setTextSize(1);
    display.print(":" + secondstr);
    display.setTextSize(1);
    display.setCursor(53,40);
    display.println("Temp: " + String(getTemp()));
    display.setCursor(53,48);
    display.println("Wilg: " + String(getHum()));
    display.display();
  }

  if(screenIndex == 1){
    time_t epochTime = timeClient.getEpochTime();
    String formattedTime = timeClient.getFormattedTime();
    String weekDay = weekDays[timeClient.getDay()];
    struct tm *ptm = gmtime ((time_t *)&epochTime);
    int monthDay = ptm->tm_mday;
    int currentMonth = ptm->tm_mon+1;
    String monthDayStr = String(monthDay);
    String currentMonthStr = String(currentMonth);
    String currentMonthName = months[currentMonth-1];
    int currentYear = ptm->tm_year+1900;
    String currentDate = String(weekDay) + "-" + String(currentMonthName) + "-" + String(currentYear);

    if(monthDayStr.length() == 1){
      monthDayStr = "0" + monthDayStr;
    }
    if(currentMonthStr.length() == 1){
      currentMonthStr = "0" + currentMonthStr;
    }

    display.clearDisplay();
    display.drawBitmap(0, 0, kurwinox, 128, 64, WHITE);
    display.setCursor(64, 0);
    display.setTextSize(3);
    display.setTextColor(WHITE);
    display.print(monthDayStr);
    display.setTextSize(2);
    display.print(weekDay);
    display.println(" ");
    display.println("       " + String(currentMonthName));
    display.println("      " + String(currentYear) + "r");
    display.display();
  }

  if(screenIndex == 2){
    display.clearDisplay();
    display.setTextSize(2);
    display.setCursor(0, 0);
    display.setTextColor(WHITE);
  }

  if(screenIndex == 3){
    display.clearDisplay();
    display.setTextSize(4);
    display.setCursor(0, 0);
    display.setTextColor(WHITE);
    display.drawBitmap(0, 0, aaa, 128, 64, WHITE);
    display.display();
  }

}
